; Generated by KSST64 v2.1

do ~~/t32.cmm
sys.res
sys.cpu CortexA55
sys.config.cn 8.
core.num 8.
sys.o mmuspaces on
sys.u
title os.pwd()

d.load.e symbols/vmlinux 0x0000002913200000 /nc /ncode
y.d _end
d.load.b SYS_COREDUMP 0xFFFF000000043000++0x0000000000007FFF /nc /skip 0x0000000000002000
d.load.b SYS_COREDUMP 0x0000000040000000++0x00000001FFFFFFFF /nc /skip 0x000000000000A000
d.load.e scrutils/cmmsym.elf /physload /nc /as
global &MemMapAddr &ModStart &LinearStart &ThreadSize
&MemMapAddr=0xFFFFFFFEFEE00000
&ModStart=0xFFFFFFC000000000
&LinearStart=0xFFFFFF8000000000
&ThreadSize=0x0000000000004000

menu.rp
(
	add
	menu
	(
		popup "Mediatek"
		(
			popup "CPU3 callstack"
			(
				menuitem "__queue_work()"
				(
					core.select 3
					r.s pc	0xFFFFFFE91B368DAC
					r.s sp 	0xFFFFFFC00801BCF0
					r.s x0	0x0000000000000000
					r.s x1	0x0000000000000000
					r.s x2	0xFFFFFF80D12F7A80
					r.s x3	0x0000000000000001
					r.s x4	0x0000000000000080
					r.s x5	0x0000000000000000
					r.s x6	0x0000000000000000
					r.s x7	0x0000000000000001
					r.s x8	0x0000000000000000
					r.s x9	0x0000000100000102
					r.s x10	0x00000001441AA743
					r.s x11	0x00000001041AA744
					r.s x12	0xFFFFFF81D8E8AEA8
					r.s x13	0x0000000000000040
					r.s x14	0xFFFFFF81D8E8AEB0
					r.s x15	0xFFFFFFFFFFFFFFFF
					r.s x16	0x0000000000000000
					r.s x17	0x00000001041AA744
					r.s x18	0xFFFFFFC00801D050
					r.s x19	0x0000000000000102
					r.s x20	0xFFFFFFE91CA36CE8
					r.s x21	0xFFFFFF80D12F7AB0
					r.s x22	0xFFFFFF80036C5C80
					r.s x23	0x00000000000000E0
					r.s x24	0xFFFFFF80036C5C80
					r.s x25	0x0000000000000001
					r.s x26	0xFFFFFFE91D956008
					r.s x27	0xFFFFFFE91D989DD8
					r.s x28	0xFFFFFFE91DB1F758
					r.s x29	0xFFFFFFC00801BD00
					r.s x30	0xFFFFFFE91B36D188
				)
				menuitem "delayed_work_timer_fn()"
				(
					core.select 3
					r.s pc	0xFFFFFFE91B36D184
					r.s sp 	0xFFFFFFC00801BD60
					r.s x0	0x0000000000000000
					r.s x1	0x0000000000000000
					r.s x2	0xFFFFFF80D12F7A80
					r.s x3	0x0000000000000001
					r.s x4	0x0000000000000080
					r.s x5	0x0000000000000000
					r.s x6	0x0000000000000000
					r.s x7	0x0000000000000001
					r.s x8	0x0000000000000000
					r.s x9	0x0000000100000102
					r.s x10	0x00000001441AA743
					r.s x11	0x00000001041AA744
					r.s x12	0xFFFFFF81D8E8AEA8
					r.s x13	0x0000000000000040
					r.s x14	0xFFFFFF81D8E8AEB0
					r.s x15	0xFFFFFFFFFFFFFFFF
					r.s x16	0x0000000000000000
					r.s x17	0x00000001041AA744
					r.s x18	0xFFFFFFC00801D050
					r.s x19	0x0000000000000102
					r.s x20	0xFFFFFFE91CA36CE8
					r.s x21	0xFFFFFF80D12F7AB0
					r.s x22	0xFFFFFF80036C5C80
					r.s x23	0x00000000000000E0
					r.s x24	0xFFFFFF80036C5C80
					r.s x25	0x0000000000000001
					r.s x26	0xFFFFFFE91D956008
					r.s x27	0xFFFFFFE91D989DD8
					r.s x28	0xFFFFFFE91DB1F758
					r.s x29	0xFFFFFFC00801BD60
					r.s x30	0xFFFFFFE91B36D188
				)
				menuitem "call_timer_fn()"
				(
					core.select 3
					r.s pc	0xFFFFFFE91B465710
					r.s sp 	0xFFFFFFC00801BD80
					r.s x0	0x0000000000000000
					r.s x1	0x0000000000000000
					r.s x2	0xFFFFFF80D12F7A80
					r.s x3	0x0000000000000001
					r.s x4	0x0000000000000080
					r.s x5	0x0000000000000000
					r.s x6	0x0000000000000000
					r.s x7	0x0000000000000001
					r.s x8	0x0000000000000000
					r.s x9	0x0000000100000102
					r.s x10	0x00000001441AA743
					r.s x11	0x00000001041AA744
					r.s x12	0xFFFFFF81D8E8AEA8
					r.s x13	0x0000000000000040
					r.s x14	0xFFFFFF81D8E8AEB0
					r.s x15	0xFFFFFFFFFFFFFFFF
					r.s x16	0x0000000000000000
					r.s x17	0x00000001041AA744
					r.s x18	0xFFFFFFC00801D050
					r.s x19	0x0000000000000102
					r.s x20	0xFFFFFFE91CA36CE8
					r.s x21	0xFFFFFF80D12F7AB0
					r.s x22	0xFFFFFF80036C5C80
					r.s x23	0x00000000000000E0
					r.s x24	0xFFFFFF80036C5C80
					r.s x25	0x0000000000000001
					r.s x26	0xFFFFFFE91D956008
					r.s x27	0xFFFFFFE91D989DD8
					r.s x28	0xFFFFFFE91DB1F758
					r.s x29	0xFFFFFFC00801BD80
					r.s x30	0xFFFFFFE91B36D188
				)
				menuitem "expire_timers()"
				(
					core.select 3
					r.s pc	0xFFFFFFE91B4653DC
					r.s sp 	0xFFFFFFC00801BDE0
					r.s x0	0x0000000000000000
					r.s x1	0x0000000000000000
					r.s x2	0xFFFFFF80D12F7A80
					r.s x3	0x0000000000000001
					r.s x4	0x0000000000000080
					r.s x5	0x0000000000000000
					r.s x6	0x0000000000000000
					r.s x7	0x0000000000000001
					r.s x8	0x0000000000000000
					r.s x9	0x0000000100000102
					r.s x10	0x00000001441AA743
					r.s x11	0x00000001041AA744
					r.s x12	0xFFFFFF81D8E8AEA8
					r.s x13	0x0000000000000040
					r.s x14	0xFFFFFF81D8E8AEB0
					r.s x15	0xFFFFFFFFFFFFFFFF
					r.s x16	0x0000000000000000
					r.s x17	0x00000001041AA744
					r.s x18	0xFFFFFFC00801D050
					r.s x19	0x0000000000000102
					r.s x20	0xFFFFFFE91CA36CE8
					r.s x21	0xFFFFFF80D12F7AB0
					r.s x22	0xFFFFFF80036C5C80
					r.s x23	0x00000000000000E0
					r.s x24	0xFFFFFF80036C5C80
					r.s x25	0x0000000000000001
					r.s x26	0xFFFFFFE91D956008
					r.s x27	0xFFFFFFE91D989DD8
					r.s x28	0xFFFFFFE91DB1F758
					r.s x29	0xFFFFFFC00801BDE0
					r.s x30	0xFFFFFFE91B36D188
				)
				menuitem "__run_timers()"
				(
					core.select 3
					r.s pc	0xFFFFFFE91B465158
					r.s sp 	0xFFFFFFC00801BE90
					r.s x0	0x0000000000000000
					r.s x1	0x0000000000000000
					r.s x2	0xFFFFFF80D12F7A80
					r.s x3	0x0000000000000001
					r.s x4	0x0000000000000080
					r.s x5	0x0000000000000000
					r.s x6	0x0000000000000000
					r.s x7	0x0000000000000001
					r.s x8	0x0000000000000000
					r.s x9	0x0000000100000102
					r.s x10	0x00000001441AA743
					r.s x11	0x00000001041AA744
					r.s x12	0xFFFFFF81D8E8AEA8
					r.s x13	0x0000000000000040
					r.s x14	0xFFFFFF81D8E8AEB0
					r.s x15	0xFFFFFFFFFFFFFFFF
					r.s x16	0x0000000000000000
					r.s x17	0x00000001041AA744
					r.s x18	0xFFFFFFC00801D050
					r.s x19	0x0000000000000102
					r.s x20	0xFFFFFFE91CA36CE8
					r.s x21	0xFFFFFF80D12F7AB0
					r.s x22	0xFFFFFF80036C5C80
					r.s x23	0x00000000000000E0
					r.s x24	0xFFFFFF80036C5C80
					r.s x25	0x0000000000000001
					r.s x26	0xFFFFFFE91D956008
					r.s x27	0xFFFFFFE91D989DD8
					r.s x28	0xFFFFFFE91DB1F758
					r.s x29	0xFFFFFFC00801BE90
					r.s x30	0xFFFFFFE91B36D188
				)
				menuitem "run_timer_softirq()"
				(
					core.select 3
					r.s pc	0xFFFFFFE91B464F38
					r.s sp 	0xFFFFFFC00801BEE0
					r.s x0	0x0000000000000000
					r.s x1	0x0000000000000000
					r.s x2	0xFFFFFF80D12F7A80
					r.s x3	0x0000000000000001
					r.s x4	0x0000000000000080
					r.s x5	0x0000000000000000
					r.s x6	0x0000000000000000
					r.s x7	0x0000000000000001
					r.s x8	0x0000000000000000
					r.s x9	0x0000000100000102
					r.s x10	0x00000001441AA743
					r.s x11	0x00000001041AA744
					r.s x12	0xFFFFFF81D8E8AEA8
					r.s x13	0x0000000000000040
					r.s x14	0xFFFFFF81D8E8AEB0
					r.s x15	0xFFFFFFFFFFFFFFFF
					r.s x16	0x0000000000000000
					r.s x17	0x00000001041AA744
					r.s x18	0xFFFFFFC00801D050
					r.s x19	0x0000000000000102
					r.s x20	0xFFFFFFE91CA36CE8
					r.s x21	0xFFFFFF80D12F7AB0
					r.s x22	0xFFFFFF80036C5C80
					r.s x23	0x00000000000000E0
					r.s x24	0xFFFFFF80036C5C80
					r.s x25	0x0000000000000001
					r.s x26	0xFFFFFFE91D956008
					r.s x27	0xFFFFFFE91D989DD8
					r.s x28	0xFFFFFFE91DB1F758
					r.s x29	0xFFFFFFC00801BEE0
					r.s x30	0xFFFFFFE91B36D188
				)
				menuitem "__do_softirq()"
				(
					core.select 3
					r.s pc	0xFFFFFFE91B2105E4
					r.s sp 	0xFFFFFFC00801BF20
					r.s x0	0x0000000000000000
					r.s x1	0x0000000000000000
					r.s x2	0xFFFFFF80D12F7A80
					r.s x3	0x0000000000000001
					r.s x4	0x0000000000000080
					r.s x5	0x0000000000000000
					r.s x6	0x0000000000000000
					r.s x7	0x0000000000000001
					r.s x8	0x0000000000000000
					r.s x9	0x0000000100000102
					r.s x10	0x00000001441AA743
					r.s x11	0x00000001041AA744
					r.s x12	0xFFFFFF81D8E8AEA8
					r.s x13	0x0000000000000040
					r.s x14	0xFFFFFF81D8E8AEB0
					r.s x15	0xFFFFFFFFFFFFFFFF
					r.s x16	0x0000000000000000
					r.s x17	0x00000001041AA744
					r.s x18	0xFFFFFFC00801D050
					r.s x19	0x0000000000000102
					r.s x20	0xFFFFFFE91CA36CE8
					r.s x21	0xFFFFFF80D12F7AB0
					r.s x22	0xFFFFFF80036C5C80
					r.s x23	0x00000000000000E0
					r.s x24	0xFFFFFF80036C5C80
					r.s x25	0x0000000000000001
					r.s x26	0xFFFFFFE91D956008
					r.s x27	0xFFFFFFE91D989DD8
					r.s x28	0xFFFFFFE91DB1F758
					r.s x29	0xFFFFFFC00801BF20
					r.s x30	0xFFFFFFE91B36D188
				)
				menuitem "__irq_exit_rcu()"
				(
					core.select 3
					r.s pc	0xFFFFFFE91B33CA50
					r.s sp 	0xFFFFFFC00801BF80
					r.s x0	0x0000000000000000
					r.s x1	0x0000000000000000
					r.s x2	0xFFFFFF80D12F7A80
					r.s x3	0x0000000000000001
					r.s x4	0x0000000000000080
					r.s x5	0x0000000000000000
					r.s x6	0x0000000000000000
					r.s x7	0x0000000000000001
					r.s x8	0x0000000000000000
					r.s x9	0x0000000100000102
					r.s x10	0x00000001441AA743
					r.s x11	0x00000001041AA744
					r.s x12	0xFFFFFF81D8E8AEA8
					r.s x13	0x0000000000000040
					r.s x14	0xFFFFFF81D8E8AEB0
					r.s x15	0xFFFFFFFFFFFFFFFF
					r.s x16	0x0000000000000000
					r.s x17	0x00000001041AA744
					r.s x18	0xFFFFFFC00801D050
					r.s x19	0x0000000000000102
					r.s x20	0xFFFFFFE91CA36CE8
					r.s x21	0xFFFFFF80D12F7AB0
					r.s x22	0xFFFFFF80036C5C80
					r.s x23	0x00000000000000E0
					r.s x24	0xFFFFFF80036C5C80
					r.s x25	0x0000000000000001
					r.s x26	0xFFFFFFE91D956008
					r.s x27	0xFFFFFFE91D989DD8
					r.s x28	0xFFFFFFE91DB1F758
					r.s x29	0xFFFFFFC00801BF80
					r.s x30	0xFFFFFFE91B36D188
				)
				menuitem "__handle_domain_irq()"
				(
					core.select 3
					r.s pc	0xFFFFFFE91B403974
					r.s sp 	0xFFFFFFC00801BFB0
					r.s x0	0x0000000000000000
					r.s x1	0x0000000000000000
					r.s x2	0xFFFFFF80D12F7A80
					r.s x3	0x0000000000000001
					r.s x4	0x0000000000000080
					r.s x5	0x0000000000000000
					r.s x6	0x0000000000000000
					r.s x7	0x0000000000000001
					r.s x8	0x0000000000000000
					r.s x9	0x0000000100000102
					r.s x10	0x00000001441AA743
					r.s x11	0x00000001041AA744
					r.s x12	0xFFFFFF81D8E8AEA8
					r.s x13	0x0000000000000040
					r.s x14	0xFFFFFF81D8E8AEB0
					r.s x15	0xFFFFFFFFFFFFFFFF
					r.s x16	0x0000000000000000
					r.s x17	0x00000001041AA744
					r.s x18	0xFFFFFFC00801D050
					r.s x19	0x0000000000000102
					r.s x20	0xFFFFFFE91CA36CE8
					r.s x21	0xFFFFFF80D12F7AB0
					r.s x22	0xFFFFFF80036C5C80
					r.s x23	0x00000000000000E0
					r.s x24	0xFFFFFF80036C5C80
					r.s x25	0x0000000000000001
					r.s x26	0xFFFFFFE91D956008
					r.s x27	0xFFFFFFE91D989DD8
					r.s x28	0xFFFFFFE91DB1F758
					r.s x29	0xFFFFFFC00801BFB0
					r.s x30	0xFFFFFFE91B36D188
				)
				menuitem "gic_handle_irq.30586()"
				(
					core.select 3
					r.s pc	0xFFFFFFE91B21037C
					r.s sp 	0xFFFFFFC00801BFE0
					r.s x0	0x0000000000000000
					r.s x1	0x0000000000000000
					r.s x2	0xFFFFFF80D12F7A80
					r.s x3	0x0000000000000001
					r.s x4	0x0000000000000080
					r.s x5	0x0000000000000000
					r.s x6	0x0000000000000000
					r.s x7	0x0000000000000001
					r.s x8	0x0000000000000000
					r.s x9	0x0000000100000102
					r.s x10	0x00000001441AA743
					r.s x11	0x00000001041AA744
					r.s x12	0xFFFFFF81D8E8AEA8
					r.s x13	0x0000000000000040
					r.s x14	0xFFFFFF81D8E8AEB0
					r.s x15	0xFFFFFFFFFFFFFFFF
					r.s x16	0x0000000000000000
					r.s x17	0x00000001041AA744
					r.s x18	0xFFFFFFC00801D050
					r.s x19	0x0000000000000102
					r.s x20	0xFFFFFFE91CA36CE8
					r.s x21	0xFFFFFF80D12F7AB0
					r.s x22	0xFFFFFF80036C5C80
					r.s x23	0x00000000000000E0
					r.s x24	0xFFFFFF80036C5C80
					r.s x25	0x0000000000000001
					r.s x26	0xFFFFFFE91D956008
					r.s x27	0xFFFFFFE91D989DD8
					r.s x28	0xFFFFFFE91DB1F758
					r.s x29	0xFFFFFFC00801BFE0
					r.s x30	0xFFFFFFE91B36D188
				)
				menuitem "0xFFFFFFE91B212620()"
				(
					core.select 3
					r.s pc	0xFFFFFFE91B212620
					r.s sp 	0xFFFFFFC02B3CBCE0
					r.s x0	0x0000000000000000
					r.s x1	0x0000000000000000
					r.s x2	0xFFFFFF80D12F7A80
					r.s x3	0x0000000000000001
					r.s x4	0x0000000000000080
					r.s x5	0x0000000000000000
					r.s x6	0x0000000000000000
					r.s x7	0x0000000000000001
					r.s x8	0x0000000000000000
					r.s x9	0x0000000100000102
					r.s x10	0x00000001441AA743
					r.s x11	0x00000001041AA744
					r.s x12	0xFFFFFF81D8E8AEA8
					r.s x13	0x0000000000000040
					r.s x14	0xFFFFFF81D8E8AEB0
					r.s x15	0xFFFFFFFFFFFFFFFF
					r.s x16	0x0000000000000000
					r.s x17	0x00000001041AA744
					r.s x18	0xFFFFFFC00801D050
					r.s x19	0x0000000000000102
					r.s x20	0xFFFFFFE91CA36CE8
					r.s x21	0xFFFFFF80D12F7AB0
					r.s x22	0xFFFFFF80036C5C80
					r.s x23	0x00000000000000E0
					r.s x24	0xFFFFFF80036C5C80
					r.s x25	0x0000000000000001
					r.s x26	0xFFFFFFE91D956008
					r.s x27	0xFFFFFFE91D989DD8
					r.s x28	0xFFFFFFE91DB1F758
					r.s x29	0xFFFFFFC02B3CBCE0
					r.s x30	0xFFFFFFE91B36D188
				)
				menuitem "finish_task_switch()"
				(
					core.select 3
					r.s pc	0xFFFFFFE91B391EE4
					r.s sp 	0xFFFFFFC02B3CBD00
					r.s x0	0xFFFFFF80CC35CA00
					r.s x1	0xFFFFFF80036C5C80
					r.s x2	0xFFFFFF80036C5C80
					r.s x3	0xFFFFFF80036C5C80
					r.s x4	0x0000000000000000
					r.s x5	0x0000000000000000
					r.s x6	0x0000000000000000
					r.s x7	0x0000000000000001
					r.s x8	0x0000000000000000
					r.s x9	0xFFFFFF80CC35CA4C
					r.s x10	0x00000000000000E0
					r.s x11	0x0000000000000000
					r.s x12	0xFFFFFFE91D331830
					r.s x13	0xFFFFFFE91B59B814
					r.s x14	0x0000000000000000
					r.s x15	0x0000000000002710
					r.s x16	0x0000000000002720
					r.s x17	0x0000000000008000
					r.s x18	0xFFFFFFC01A7A7028
					r.s x19	0xFFFFFF81D8E99E40
					r.s x20	0xFFFFFF80CC35CA00
					r.s x21	0x0000000000000000
					r.s x22	0xFFFFFF80036C5C80
					r.s x23	0xFFFFFFE91CC0245C
					r.s x24	0x0000000000000002
					r.s x25	0x0000000000000002
					r.s x26	0xFFFFFF80036C5C80
					r.s x27	0xFFFFFFE91D4F2020
					r.s x28	0xFFFFFFE91CA1B6E8
					r.s x29	0xFFFFFFC02B3CBD00
					r.s x30	0xFFFFFFE91CC0245C
				)
				menuitem "__schedule()"
				(
					core.select 3
					r.s pc	0xFFFFFFE91CC02458
					r.s sp 	0xFFFFFFC02B3CBD80
					r.s x0	0xFFFFFF80CC35CA00
					r.s x1	0xFFFFFF80036C5C80
					r.s x2	0xFFFFFF80036C5C80
					r.s x3	0xFFFFFF80036C5C80
					r.s x4	0x0000000000000000
					r.s x5	0x0000000000000000
					r.s x6	0x0000000000000000
					r.s x7	0x0000000000000001
					r.s x8	0x0000000000000000
					r.s x9	0xFFFFFF80CC35CA4C
					r.s x10	0x00000000000000E0
					r.s x11	0x0000000000000000
					r.s x12	0xFFFFFFE91D331830
					r.s x13	0xFFFFFFE91B59B814
					r.s x14	0x0000000000000000
					r.s x15	0x0000000000002710
					r.s x16	0x0000000000002720
					r.s x17	0x0000000000008000
					r.s x18	0xFFFFFFC01A7A7028
					r.s x19	0xFFFFFF81D8E99E40
					r.s x20	0xFFFFFF80CC35CA00
					r.s x21	0x0000000000000000
					r.s x22	0xFFFFFF80036C5C80
					r.s x23	0xFFFFFFE91CC0245C
					r.s x24	0x0000000000000002
					r.s x25	0x0000000000000002
					r.s x26	0xFFFFFF80036C5C80
					r.s x27	0xFFFFFFE91D4F2020
					r.s x28	0xFFFFFFE91CA1B6E8
					r.s x29	0xFFFFFFC02B3CBD80
					r.s x30	0xFFFFFFE91CC0245C
				)
				menuitem "schedule()"
				(
					core.select 3
					r.s pc	0xFFFFFFE91CC02B60
					r.s sp 	0xFFFFFFC02B3CBDE0
					r.s x0	0xFFFFFF80CC35CA00
					r.s x1	0xFFFFFF80036C5C80
					r.s x2	0xFFFFFF80036C5C80
					r.s x3	0xFFFFFF80036C5C80
					r.s x4	0x0000000000000000
					r.s x5	0x0000000000000000
					r.s x6	0x0000000000000000
					r.s x7	0x0000000000000001
					r.s x8	0x0000000000000000
					r.s x9	0xFFFFFF80CC35CA4C
					r.s x10	0x00000000000000E0
					r.s x11	0x0000000000000000
					r.s x12	0xFFFFFFE91D331830
					r.s x13	0xFFFFFFE91B59B814
					r.s x14	0x0000000000000000
					r.s x15	0x0000000000002710
					r.s x16	0x0000000000002720
					r.s x17	0x0000000000008000
					r.s x18	0xFFFFFFC01A7A7028
					r.s x19	0xFFFFFF81D8E99E40
					r.s x20	0xFFFFFF80CC35CA00
					r.s x21	0x0000000000000000
					r.s x22	0xFFFFFF80036C5C80
					r.s x23	0xFFFFFFE91CC0245C
					r.s x24	0x0000000000000002
					r.s x25	0x0000000000000002
					r.s x26	0xFFFFFF80036C5C80
					r.s x27	0xFFFFFFE91D4F2020
					r.s x28	0xFFFFFFE91CA1B6E8
					r.s x29	0xFFFFFFC02B3CBDE0
					r.s x30	0xFFFFFFE91CC0245C
				)
				menuitem "worker_thread()"
				(
					core.select 3
					r.s pc	0xFFFFFFE91B370BB8
					r.s sp 	0xFFFFFFC02B3CBE10
					r.s x0	0xFFFFFF80CC35CA00
					r.s x1	0xFFFFFF80036C5C80
					r.s x2	0xFFFFFF80036C5C80
					r.s x3	0xFFFFFF80036C5C80
					r.s x4	0x0000000000000000
					r.s x5	0x0000000000000000
					r.s x6	0x0000000000000000
					r.s x7	0x0000000000000001
					r.s x8	0x0000000000000000
					r.s x9	0xFFFFFF80CC35CA4C
					r.s x10	0x00000000000000E0
					r.s x11	0x0000000000000000
					r.s x12	0xFFFFFFE91D331830
					r.s x13	0xFFFFFFE91B59B814
					r.s x14	0x0000000000000000
					r.s x15	0x0000000000002710
					r.s x16	0x0000000000002720
					r.s x17	0x0000000000008000
					r.s x18	0xFFFFFFC01A7A7028
					r.s x19	0xFFFFFF81D8E99E40
					r.s x20	0xFFFFFF80CC35CA00
					r.s x21	0x0000000000000000
					r.s x22	0xFFFFFF80036C5C80
					r.s x23	0xFFFFFFE91CC0245C
					r.s x24	0x0000000000000002
					r.s x25	0x0000000000000002
					r.s x26	0xFFFFFF80036C5C80
					r.s x27	0xFFFFFFE91D4F2020
					r.s x28	0xFFFFFFE91CA1B6E8
					r.s x29	0xFFFFFFC02B3CBE10
					r.s x30	0xFFFFFFE91CC0245C
				)
				menuitem "kthread()"
				(
					core.select 3
					r.s pc	0xFFFFFFE91B37F498
					r.s sp 	0xFFFFFFC02B3CBE70
					r.s x0	0xFFFFFF80CC35CA00
					r.s x1	0xFFFFFF80036C5C80
					r.s x2	0xFFFFFF80036C5C80
					r.s x3	0xFFFFFF80036C5C80
					r.s x4	0x0000000000000000
					r.s x5	0x0000000000000000
					r.s x6	0x0000000000000000
					r.s x7	0x0000000000000001
					r.s x8	0x0000000000000000
					r.s x9	0xFFFFFF80CC35CA4C
					r.s x10	0x00000000000000E0
					r.s x11	0x0000000000000000
					r.s x12	0xFFFFFFE91D331830
					r.s x13	0xFFFFFFE91B59B814
					r.s x14	0x0000000000000000
					r.s x15	0x0000000000002710
					r.s x16	0x0000000000002720
					r.s x17	0x0000000000008000
					r.s x18	0xFFFFFFC01A7A7028
					r.s x19	0xFFFFFF81D8E99E40
					r.s x20	0xFFFFFF80CC35CA00
					r.s x21	0x0000000000000000
					r.s x22	0xFFFFFF80036C5C80
					r.s x23	0xFFFFFFE91CC0245C
					r.s x24	0x0000000000000002
					r.s x25	0x0000000000000002
					r.s x26	0xFFFFFF80036C5C80
					r.s x27	0xFFFFFFE91D4F2020
					r.s x28	0xFFFFFFE91CA1B6E8
					r.s x29	0xFFFFFFC02B3CBE70
					r.s x30	0xFFFFFFE91CC0245C
				)
				menuitem "0xFFFFFFE91B21591C()"
				(
					core.select 3
					r.s pc	0xFFFFFFE91B21591C
					r.s sp 	0x0000000000000000
					r.s x0	0xFFFFFF80CC35CA00
					r.s x1	0xFFFFFF80036C5C80
					r.s x2	0xFFFFFF80036C5C80
					r.s x3	0xFFFFFF80036C5C80
					r.s x4	0x0000000000000000
					r.s x5	0x0000000000000000
					r.s x6	0x0000000000000000
					r.s x7	0x0000000000000001
					r.s x8	0x0000000000000000
					r.s x9	0xFFFFFF80CC35CA4C
					r.s x10	0x00000000000000E0
					r.s x11	0x0000000000000000
					r.s x12	0xFFFFFFE91D331830
					r.s x13	0xFFFFFFE91B59B814
					r.s x14	0x0000000000000000
					r.s x15	0x0000000000002710
					r.s x16	0x0000000000002720
					r.s x17	0x0000000000008000
					r.s x18	0xFFFFFFC01A7A7028
					r.s x19	0xFFFFFF81D8E99E40
					r.s x20	0xFFFFFF80CC35CA00
					r.s x21	0x0000000000000000
					r.s x22	0xFFFFFF80036C5C80
					r.s x23	0xFFFFFFE91CC0245C
					r.s x24	0x0000000000000002
					r.s x25	0x0000000000000002
					r.s x26	0xFFFFFF80036C5C80
					r.s x27	0xFFFFFFE91D4F2020
					r.s x28	0xFFFFFFE91CA1B6E8
					r.s x29	0x0000000000000000
					r.s x30	0xFFFFFFE91CC0245C
				)
			)
		)
	)
)

core.select 7
r.s sp_el0	0xFFFFFF80C01F0000
r.s cpsr	0x0000000080C00085
r.s pc	0xFFFFFFE91C956864
r.s sp 	0xFFFFFFC00813BE50
r.s x0	0xFFFFFF81D8F1CBC0
r.s x1	0xFFFFFF80C4BD7080
r.s x2	0x0000000000000000
r.s x3	0x0000000000000010
r.s x4	0x0000000000000080
r.s x5	0x0000000000000001
r.s x6	0x0000000000000000
r.s x7	0x0000000000000001
r.s x8	0xFFFFFF98BB5B2000
r.s x9	0x0000000032E758A0
r.s x10	0x0000000032E7589E
r.s x11	0x000000000353F7CF
r.s x12	0x0000000000000020
r.s x13	0x00000000082EB986
r.s x14	0xFFFFFF81D8F11958
r.s x15	0x0000FAC4AAEA0F00
r.s x16	0x0000000000000000
r.s x17	0x0000000000000240
r.s x18	0xFFFFFFC00812D030
r.s x19	0x00000067E5F47D61
r.s x20	0xFFFFFFE91CA1B6E8
r.s x21	0xFFFFFFE91CA1A6A8
r.s x22	0x0000FA5CC3FC331D
r.s x23	0xFFFFFF80C4BD7098
r.s x24	0x0CFCBE8FAC24C459
r.s x25	0xFFFFFFE91DA2C880
r.s x26	0x00000000099D89D9
r.s x27	0xFFFFFFE91D989000
r.s x28	0xFFFFFFE91DBB8660
r.s x29	0xFFFFFFC00813BE50
r.s x30	0xFFFFFFE91C956848
per.s spr:0x30201 %q 0x000000004247C000
per.s spr:0x30202 %q 0x000001F2B5593519
per.s spr:0x30100 %q 0x000000003474D91D
per.s spr:0x30A20 %q 0x0000BBFF440C0400
per.s spr:0x30A30 %q 0x0000000000000000

core.select 6
r.s sp_el0	0x0000007FD835EBD0
r.s cpsr	0x0000000060001000
r.s pc	0x000000604179B0D0
r.s sp 	0xFFFFFFC020234000
r.s x0	0x0000000000000000
r.s x1	0x000000775617AD28
r.s x2	0x0000000000000000
r.s x3	0x0000000000000008
r.s x4	0x000000775617ACC0
r.s x5	0x00000079EB33AFD0
r.s x6	0x000000775617ACB0
r.s x7	0x00000000ACD979CE
r.s x8	0x0000000000000007
r.s x9	0x000000604179D4A0
r.s x10	0x0000000080000000
r.s x11	0x0000000000000000
r.s x12	0xFFFFFF80FFFFFFE0
r.s x13	0x00000000FFFFFFFF
r.s x14	0x0000000000000001
r.s x15	0x00000000FFFFFFA5
r.s x16	0x00000079EB3AA210
r.s x17	0x00000079EB3456E0
r.s x18	0x00000079EDF6C000
r.s x19	0x000000604179D000
r.s x20	0xB40000794ADF7BD0
r.s x21	0x0000000000000006
r.s x22	0xB40000782ADF4640
r.s x23	0x000000604179A7AC
r.s x24	0xB40000782ADF4610
r.s x25	0x0000000000000006
r.s x26	0xB40000794ADF7B70
r.s x27	0x00000060417990A4
r.s x28	0x00000079ED3AC000
r.s x29	0x0000007FD835EC00
r.s x30	0x000000604179B0B4
per.s spr:0x30201 %q 0x000000004247C000
per.s spr:0x30202 %q 0x000001F2B5593519
per.s spr:0x30100 %q 0x000000003474D91D
per.s spr:0x30A20 %q 0x0000BBFF440C0400
per.s spr:0x30A30 %q 0x0000000000000000

core.select 5
r.s sp_el0	0xFFFFFF80C01F5C80
r.s cpsr	0x0000000080C00085
r.s pc	0xFFFFFFE91C956864
r.s sp 	0xFFFFFFC00812BE50
r.s x0	0xFFFFFF81D8EDABC0
r.s x1	0xFFFFFF80C4BD0880
r.s x2	0x0000000000000000
r.s x3	0x0000000000000010
r.s x4	0x0000000000000080
r.s x5	0x0000000000000001
r.s x6	0x0000000000000000
r.s x7	0x0000000000000001
r.s x8	0xFFFFFF98BB570000
r.s x9	0x00000000893666AC
r.s x10	0x00000000893666AA
r.s x11	0x000000000353F7CF
r.s x12	0x0000000000000020
r.s x13	0x00000000082EB98C
r.s x14	0x0000000000000010
r.s x15	0x0000000000000010
r.s x16	0x0000000000000001
r.s x17	0x0000000000008000
r.s x18	0xFFFFFFC00811D030
r.s x19	0x00000067E67C04FE
r.s x20	0xFFFFFFE91CA1B6E8
r.s x21	0xFFFFFFE91CA1A6A8
r.s x22	0x0000FA5CC3FC331D
r.s x23	0xFFFFFF80C4BD0898
r.s x24	0x0CFCCF809FC2FBAC
r.s x25	0xFFFFFFE91DA2C880
r.s x26	0x00000000099D89D9
r.s x27	0xFFFFFFE91D989000
r.s x28	0xFFFFFFE91DBB8660
r.s x29	0xFFFFFFC00812BE50
r.s x30	0xFFFFFFE91C956848
per.s spr:0x30201 %q 0x000000004247C000
per.s spr:0x30202 %q 0x000000F2B5593519
per.s spr:0x30100 %q 0x000000003474591D
per.s spr:0x30A20 %q 0x0000BBFF440C0400
per.s spr:0x30A30 %q 0x0000000000000000

core.select 4
r.s sp_el0	0xFFFFFF80C01F4A00
r.s cpsr	0x0000000080C00085
r.s pc	0xFFFFFFE91C956864
r.s sp 	0xFFFFFFC008123E50
r.s x0	0xFFFFFF81D8EB9BC0
r.s x1	0xFFFFFF80C4BD4080
r.s x2	0x0000000000000000
r.s x3	0x0000000000000010
r.s x4	0x0000000000000080
r.s x5	0x0000000000000001
r.s x6	0x0000000000000000
r.s x7	0x0000000000000001
r.s x8	0xFFFFFF98BB54F000
r.s x9	0x000000007CBC8358
r.s x10	0x000000007CBC8356
r.s x11	0x000000000353F7CF
r.s x12	0x0000000000000020
r.s x13	0x00000000082EB988
r.s x14	0xFFFFFF81D8EAE958
r.s x15	0x0000FAC4AAEA0F00
r.s x16	0x0000000000000000
r.s x17	0x0000000000008000
r.s x18	0xFFFFFFC008115030
r.s x19	0x00000067E6368D56
r.s x20	0xFFFFFFE91CA1B6E8
r.s x21	0xFFFFFFE91CA1A6A8
r.s x22	0x0000FA5CC3FC331D
r.s x23	0xFFFFFF80C4BD4098
r.s x24	0x0CFCC6D1AAD653FC
r.s x25	0xFFFFFFE91DA2C880
r.s x26	0x00000000099D89D9
r.s x27	0xFFFFFFE91D989000
r.s x28	0xFFFFFFE91DBB8660
r.s x29	0xFFFFFFC008123E50
r.s x30	0xFFFFFFE91C956848
per.s spr:0x30201 %q 0x000000004247C000
per.s spr:0x30202 %q 0x000000F2B5593519
per.s spr:0x30100 %q 0x000000003474591D
per.s spr:0x30A20 %q 0x0000BBFF440C0400
per.s spr:0x30A30 %q 0x0000000000000000

core.select 3
r.s sp_el0	0xFFFFFF80036C5C80
r.s cpsr	0x0000000080400085
r.s pc	0xFFFFFFE91B368DAC
r.s sp 	0xFFFFFFC00801BCF0
r.s x0	0x0000000000000000
r.s x1	0x0000000000000000
r.s x2	0xFFFFFF80D12F7A80
r.s x3	0x0000000000000001
r.s x4	0x0000000000000080
r.s x5	0x0000000000000000
r.s x6	0x0000000000000000
r.s x7	0x0000000000000001
r.s x8	0x0000000000000000
r.s x9	0x0000000100000102
r.s x10	0x00000001441AA743
r.s x11	0x00000001041AA744
r.s x12	0xFFFFFF81D8E8AEA8
r.s x13	0x0000000000000040
r.s x14	0xFFFFFF81D8E8AEB0
r.s x15	0xFFFFFFFFFFFFFFFF
r.s x16	0x0000000000000000
r.s x17	0x00000001041AA744
r.s x18	0xFFFFFFC00801D050
r.s x19	0x0000000000000102
r.s x20	0xFFFFFFE91CA36CE8
r.s x21	0xFFFFFF80D12F7AB0
r.s x22	0xFFFFFF80036C5C80
r.s x23	0x00000000000000E0
r.s x24	0xFFFFFF80036C5C80
r.s x25	0x0000000000000001
r.s x26	0xFFFFFFE91D956008
r.s x27	0xFFFFFFE91D989DD8
r.s x28	0xFFFFFFE91DB1F758
r.s x29	0xFFFFFFC00801BD00
r.s x30	0xFFFFFFE91B36D188
per.s spr:0x30201 %q 0x000000004247C000
per.s spr:0x30202 %q 0x000000F2B5593519
per.s spr:0x30100 %q 0x000000003474591D
per.s spr:0x30A20 %q 0x0000BBFF440C0400
per.s spr:0x30A30 %q 0x0000000000000000

core.select 2
r.s sp_el0	0xFFFFFF80C01E3780
r.s cpsr	0x0000000080C00085
r.s pc	0xFFFFFFE91C956864
r.s sp 	0xFFFFFFC008113E50
r.s x0	0xFFFFFF81D8E77BC0
r.s x1	0xFFFFFF80C4BD4880
r.s x2	0x0000000000000000
r.s x3	0x0000000000000010
r.s x4	0x0000000000000080
r.s x5	0x0000000000000001
r.s x6	0x0000000000000000
r.s x7	0x0000000000000001
r.s x8	0xFFFFFF98BB50D000
r.s x9	0x000000004F2D4A88
r.s x10	0x000000004F2D4A86
r.s x11	0x000000000353F7CF
r.s x12	0x0000000000000020
r.s x13	0x00000000082EB988
r.s x14	0xFFFFFF81D8E6C958
r.s x15	0x0000FAC4AAEA0F00
r.s x16	0x0000000000000000
r.s x17	0x0000000000008000
r.s x18	0xFFFFFFC008105030
r.s x19	0x00000067E63748D6
r.s x20	0xFFFFFFE91CA1B6E8
r.s x21	0xFFFFFFE91CA1A6A8
r.s x22	0x0000FA5CC3FC331D
r.s x23	0xFFFFFF80C4BD4898
r.s x24	0x0CFCC6E91AD654EC
r.s x25	0xFFFFFFE91DA2C880
r.s x26	0x00000000099D89D9
r.s x27	0xFFFFFFE91D989000
r.s x28	0xFFFFFFE91DBB8660
r.s x29	0xFFFFFFC008113E50
r.s x30	0xFFFFFFE91C956848
per.s spr:0x30201 %q 0x000000004247C000
per.s spr:0x30202 %q 0x000000F2B5593519
per.s spr:0x30100 %q 0x000000003474591D
per.s spr:0x30A20 %q 0x0000BBFF440C0400
per.s spr:0x30A30 %q 0x0000000000000000

core.select 1
r.s sp_el0	0xFFFFFF80C01E0000
r.s cpsr	0x0000000080C00085
r.s pc	0xFFFFFFE91C956864
r.s sp 	0xFFFFFFC00810BE50
r.s x0	0xFFFFFF81D8E56BC0
r.s x1	0xFFFFFF80C49A5080
r.s x2	0x0000000000000000
r.s x3	0x0000000000000010
r.s x4	0x0000000000000080
r.s x5	0x0000000000000001
r.s x6	0x0000000000000000
r.s x7	0x0000000000000001
r.s x8	0xFFFFFF98BB4EC000
r.s x9	0x000000001CF5C704
r.s x10	0x000000001CF5C702
r.s x11	0x000000000353F7CF
r.s x12	0x0000000000000020
r.s x13	0x00000000082EB98E
r.s x14	0xFFFFFF81B7448320
r.s x15	0x0000FBF8FB8E3F3E
r.s x16	0x0000021BD105CDC1
r.s x17	0x0000000000008000
r.s x18	0xFFFFFFC0080FD030
r.s x19	0x00000067E6BAC24A
r.s x20	0xFFFFFFE91CA1B6E8
r.s x21	0xFFFFFFE91CA1A6A8
r.s x22	0x0000FA5CC3FC331D
r.s x23	0xFFFFFF80C49A5098
r.s x24	0x0CFCD758494D2498
r.s x25	0xFFFFFFE91DA2C880
r.s x26	0x00000000099D89D9
r.s x27	0xFFFFFFE91D989000
r.s x28	0xFFFFFFE91DBB8660
r.s x29	0xFFFFFFC00810BE50
r.s x30	0xFFFFFFE91C956848
per.s spr:0x30201 %q 0x000000004247C000
per.s spr:0x30202 %q 0x000000F2B5593519
per.s spr:0x30100 %q 0x000000003474591D
per.s spr:0x30A20 %q 0x0000BBFF440C0400
per.s spr:0x30A30 %q 0x0000000000000000

core.select 0
r.s sp_el0	0xFFFFFFE91D99BE80
r.s cpsr	0x0000000080C00085
r.s pc	0xFFFFFFE91C956864
r.s sp 	0xFFFFFFE91D983E00
r.s x0	0xFFFFFF81D8E35BC0
r.s x1	0xFFFFFF80C49A3080
r.s x2	0x0000000000000000
r.s x3	0x0000000000000010
r.s x4	0x0000000000000080
r.s x5	0x0000000000000001
r.s x6	0x0000000000000000
r.s x7	0x0000000000000000
r.s x8	0xFFFFFF98BB4CB000
r.s x9	0x00000000E9CF63D4
r.s x10	0x00000000E9CF63D2
r.s x11	0xFFFFFFE91D989DD8
r.s x12	0x0000000000000003
r.s x13	0x000000000000000D
r.s x14	0x0000000002FAF07F
r.s x15	0x0000000000002710
r.s x16	0x0000000000002720
r.s x17	0x0000000000008000
r.s x18	0xFFFFFFE91D99D140
r.s x19	0x00000067E6BA9705
r.s x20	0xFFFFFFE91CA1B6E8
r.s x21	0xFFFFFFE91CA1A6A8
r.s x22	0x0000FA5CC3FC331D
r.s x23	0xFFFFFF80C49A3098
r.s x24	0x0CFCD752E0AF9A88
r.s x25	0xFFFFFFE91DA2C880
r.s x26	0x00000000099D89D9
r.s x27	0xFFFFFFE91D989000
r.s x28	0xFFFFFFE91DBB8660
r.s x29	0xFFFFFFE91D983E00
r.s x30	0xFFFFFFE91C956848
per.s spr:0x30201 %q 0x000000004247C000
per.s spr:0x30202 %q 0x000000F2B5593519
per.s spr:0x30100 %q 0x000000003474591D
per.s spr:0x30A20 %q 0x0000BBFF440C0400
per.s spr:0x30A30 %q 0x0000000000000000
mmu.format linuxswap3 A:0x000000004247C000
trans.common 0xFFFFFF8000000000--0xFFFFFFFFFFFFFFFF
trans.tw on
trans.on

core.select 3
y.spath src
setup.v %h.on %s.on %y.on
wclear
wpos 0% 0% 50% 100%
w.v.f /a /l
wpos 50% 0%
w.r
wpos 50% 30%
d.l
enddo
newfile:
	entry &file
	dialog
	(&
		header "New file exist"
		pos 0. 0. 28. 1.
		text "[Warning]Detect &file exist."
		text "Please rerun 'NK/KE-Analyze' to check if matched."
		pos 2. 3. 24. 1.
		defbutton "OK" "quit"
		close "quit"
	)
	enddo