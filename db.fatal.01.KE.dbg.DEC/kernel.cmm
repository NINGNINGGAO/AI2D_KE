;******************************************************
;******************************************************
B::AREA
local &vmlinux_file
&vmlinux_file=".\vmlinux"
IF OS.FILE("&vmlinux_file")!=TRUE()
(
    dialog.view
    (
          header "Load Vmlinux"
          pos 0. 0. 30. 3.
          box "File path"
          pos 1. 1. 20. 1.
vmlinux_file:     defedit "" ""
          pos 22. 1. 7. 1.
          button "Browse..."
          (
            dialog.file "*.*"
            entry %line &file
            dialog.set vmlinux_file "&file"
          )
          pos 6. 3. 7. 1.
          defbutton "Ok"
          (                        &vmlinux_file=dialog.string(vmlinux_file)
            continue
          )
          pos 17. 3. 7. 1.
          button "Cancel"  "continue"
    )
    STOP
    dialog.end
)

local &ramdump_elf_core_file
&ramdump_elf_core_file=".\SYS_COREDUMP"
IF OS.FILE("&ramdump_elf_core_file")!=TRUE()
(
    dialog.view
    (
          header "Load RAMDUMP(Core ELF)"
          pos 0. 0. 30. 3.
          box "File path"
          pos 1. 1. 20. 1.
ramdump_elf_core_file:     defedit "" ""
          pos 22. 1. 7. 1.
          button "Browse..."
          (
            dialog.file "*.*"
            entry %line &file
            dialog.set ramdump_elf_core_file "&file"
          )
          pos 6. 3. 7. 1.
          defbutton "Ok"
          (                        &ramdump_elf_core_file=dialog.string(ramdump_elf_core_file)
            continue
          )
          pos 17. 3. 7. 1.
          button "Cancel"  "continue"
    )
    STOP
    dialog.end
)

sys.res
sys.config.cn 8
core.num 8
sys.o mmuspaces on
sys.u
title os.pwd()

d.load.e &vmlinux_file 0x0
&vmlinux_banner=V.STRING(linux_banner)
&vmlinux_banner_len=STRing.LENgth("&vmlinux_banner")
&vmlinux_build_time=STRing.SPLIT(V.STRING(&linux_banner[200]),"#", -1)
d.load.e &ramdump_elf_core_file /nc /ny /physload


;Kernel Oops
; CPU0's Registers
core.select 0
R.S X0 0xffffff81d8e35bc0
R.S X1 0xffffff80c49a3080
R.S X2 0x0000000000000000
R.S X3 0x0000000000000010
R.S X4 0x0000000000000080
R.S X5 0x0000000000000001
R.S X6 0x0000000000000000
R.S X7 0x0000000000000000
R.S X8 0xffffff98bb4cb000
R.S X9 0x00000000e9cf63d4
R.S X10 0x00000000e9cf63d2
R.S X11 0xffffffe91d989dd8
R.S X12 0x0000000000000003
R.S X13 0x000000000000000d
R.S X14 0x0000000002faf07f
R.S X15 0x0000000000002710
R.S X16 0x0000000000002720
R.S X17 0x0000000000008000
R.S X18 0xffffffe91d99d140
R.S X19 0x00000067e6ba9705
R.S X20 0xffffffe91ca1b6e8
R.S X21 0xffffffe91ca1a6a8
R.S X22 0x0000fa5cc3fc331d
R.S X23 0xffffff80c49a3098
R.S X24 0x0cfcd752e0af9a88
R.S X25 0xffffffe91da2c880
R.S X26 0x00000000099d89d9
R.S X27 0xffffffe91d989000
R.S X28 0xffffffe91dbb8660
R.S X29 0xffffffe91d983e00
R.S X30 0xffffffe91c956848
R.S SP 0xffffffe91d983e00
R.S PC 0xffffffe91c956864
R.S CPSR 0x80c00085
; END CPU Regs
; CPU0's MMU & System Control Registers
PER.Set SPR:0x30200 %QUAD 0xff8400015e4c3001 ;TTBR0_EL1
PER.Set SPR:0x34200 %QUAD 0x0000000000000000 ;TTBR0_EL2
PER.Set SPR:0x36200 %QUAD 0x0000000000000000 ;TTBR0_EL3
PER.Set SPR:0x30201 %QUAD 0xff8400004247c001 ;TTBR1_EL1
PER.Set SPR:0x30100 %QUAD 0x000000003474591d ;SCTLR_EL1
PER.Set SPR:0x34100 %QUAD 0x0000000000000000 ;SCTLR_EL2
PER.Set SPR:0x36100 %QUAD 0x0000000000000000 ;SCTLR_EL3
PER.Set SPR:0x30202 %QUAD 0x000000f2b5593519 ;TCR_EL1
PER.Set SPR:0x34202 %QUAD 0x0000000000000000 ;TCR_EL2
PER.Set SPR:0x36202 %QUAD 0x0000000000000000 ;TCR_EL3
R.S sp_el0 0xffffffe91d99be80
R.S sp_el1 0xffffffe91d983e00
R.S sp_el2 0x0000000000000000
R.S sp_el3 0x0000000000000000
; END MMU & SCTLR
; CPU1's Registers
core.select 1
R.S X0 0xffffff81d8e56bc0
R.S X1 0xffffff80c49a5080
R.S X2 0x0000000000000000
R.S X3 0x0000000000000010
R.S X4 0x0000000000000080
R.S X5 0x0000000000000001
R.S X6 0x0000000000000000
R.S X7 0x0000000000000001
R.S X8 0xffffff98bb4ec000
R.S X9 0x000000001cf5c704
R.S X10 0x000000001cf5c702
R.S X11 0x000000000353f7cf
R.S X12 0x0000000000000020
R.S X13 0x00000000082eb98e
R.S X14 0xffffff81b7448320
R.S X15 0x0000fbf8fb8e3f3e
R.S X16 0x0000021bd105cdc1
R.S X17 0x0000000000008000
R.S X18 0xffffffc0080fd030
R.S X19 0x00000067e6bac24a
R.S X20 0xffffffe91ca1b6e8
R.S X21 0xffffffe91ca1a6a8
R.S X22 0x0000fa5cc3fc331d
R.S X23 0xffffff80c49a5098
R.S X24 0x0cfcd758494d2498
R.S X25 0xffffffe91da2c880
R.S X26 0x00000000099d89d9
R.S X27 0xffffffe91d989000
R.S X28 0xffffffe91dbb8660
R.S X29 0xffffffc00810be50
R.S X30 0xffffffe91c956848
R.S SP 0xffffffc00810be50
R.S PC 0xffffffe91c956864
R.S CPSR 0x80c00085
; END CPU Regs
; CPU1's MMU & System Control Registers
PER.Set SPR:0x30200 %QUAD 0x03ea000161162001 ;TTBR0_EL1
PER.Set SPR:0x34200 %QUAD 0x0000000000000000 ;TTBR0_EL2
PER.Set SPR:0x36200 %QUAD 0x0000000000000000 ;TTBR0_EL3
PER.Set SPR:0x30201 %QUAD 0x03ea00004247c001 ;TTBR1_EL1
PER.Set SPR:0x30100 %QUAD 0x000000003474591d ;SCTLR_EL1
PER.Set SPR:0x34100 %QUAD 0x0000000000000000 ;SCTLR_EL2
PER.Set SPR:0x36100 %QUAD 0x0000000000000000 ;SCTLR_EL3
PER.Set SPR:0x30202 %QUAD 0x000000f2b5593519 ;TCR_EL1
PER.Set SPR:0x34202 %QUAD 0x0000000000000000 ;TCR_EL2
PER.Set SPR:0x36202 %QUAD 0x0000000000000000 ;TCR_EL3
R.S sp_el0 0xffffff80c01e0000
R.S sp_el1 0xffffffc00810be50
R.S sp_el2 0x0000000000000000
R.S sp_el3 0x0000000000000000
; END MMU & SCTLR
; CPU2's Registers
core.select 2
R.S X0 0xffffff81d8e77bc0
R.S X1 0xffffff80c4bd4880
R.S X2 0x0000000000000000
R.S X3 0x0000000000000010
R.S X4 0x0000000000000080
R.S X5 0x0000000000000001
R.S X6 0x0000000000000000
R.S X7 0x0000000000000001
R.S X8 0xffffff98bb50d000
R.S X9 0x000000004f2d4a88
R.S X10 0x000000004f2d4a86
R.S X11 0x000000000353f7cf
R.S X12 0x0000000000000020
R.S X13 0x00000000082eb988
R.S X14 0xffffff81d8e6c958
R.S X15 0x0000fac4aaea0f00
R.S X16 0x0000000000000000
R.S X17 0x0000000000008000
R.S X18 0xffffffc008105030
R.S X19 0x00000067e63748d6
R.S X20 0xffffffe91ca1b6e8
R.S X21 0xffffffe91ca1a6a8
R.S X22 0x0000fa5cc3fc331d
R.S X23 0xffffff80c4bd4898
R.S X24 0x0cfcc6e91ad654ec
R.S X25 0xffffffe91da2c880
R.S X26 0x00000000099d89d9
R.S X27 0xffffffe91d989000
R.S X28 0xffffffe91dbb8660
R.S X29 0xffffffc008113e50
R.S X30 0xffffffe91c956848
R.S SP 0xffffffc008113e50
R.S PC 0xffffffe91c956864
R.S CPSR 0x80c00085
; END CPU Regs
; CPU2's MMU & System Control Registers
PER.Set SPR:0x30200 %QUAD 0x35560001a72cc001 ;TTBR0_EL1
PER.Set SPR:0x34200 %QUAD 0x0000000000000000 ;TTBR0_EL2
PER.Set SPR:0x36200 %QUAD 0x0000000000000000 ;TTBR0_EL3
PER.Set SPR:0x30201 %QUAD 0x355600004247c001 ;TTBR1_EL1
PER.Set SPR:0x30100 %QUAD 0x000000003474591d ;SCTLR_EL1
PER.Set SPR:0x34100 %QUAD 0x0000000000000000 ;SCTLR_EL2
PER.Set SPR:0x36100 %QUAD 0x0000000000000000 ;SCTLR_EL3
PER.Set SPR:0x30202 %QUAD 0x000000f2b5593519 ;TCR_EL1
PER.Set SPR:0x34202 %QUAD 0x0000000000000000 ;TCR_EL2
PER.Set SPR:0x36202 %QUAD 0x0000000000000000 ;TCR_EL3
R.S sp_el0 0xffffff80c01e3780
R.S sp_el1 0xffffffc008113e50
R.S sp_el2 0x0000000000000000
R.S sp_el3 0x0000000000000000
; END MMU & SCTLR
; CPU3's Registers
core.select 3
R.S X0 0x0000000000000000
R.S X1 0x0000000000000000
R.S X2 0xffffff80d12f7a80
R.S X3 0x0000000000000001
R.S X4 0x0000000000000080
R.S X5 0x0000000000000000
R.S X6 0x0000000000000000
R.S X7 0x0000000000000001
R.S X8 0x0000000000000000
R.S X9 0x0000000100000102
R.S X10 0x00000001441aa743
R.S X11 0x00000001041aa744
R.S X12 0xffffff81d8e8aea8
R.S X13 0x0000000000000040
R.S X14 0xffffff81d8e8aeb0
R.S X15 0xffffffffffffffff
R.S X16 0x0000000000000000
R.S X17 0x00000001041aa744
R.S X18 0xffffffc00801d050
R.S X19 0x0000000000000102
R.S X20 0xffffffe91ca36ce8
R.S X21 0xffffff80d12f7ab0
R.S X22 0xffffff80036c5c80
R.S X23 0x00000000000000e0
R.S X24 0xffffff80036c5c80
R.S X25 0x0000000000000001
R.S X26 0xffffffe91d956008
R.S X27 0xffffffe91d989dd8
R.S X28 0xffffffe91db1f758
R.S X29 0xffffffc00801bd00
R.S X30 0xffffffe91b36d188
R.S SP 0xffffffc00801bcf0
R.S PC 0xffffffe91b368dac
R.S CPSR 0x80400085
; END CPU Regs
; CPU3's MMU & System Control Registers
PER.Set SPR:0x30200 %QUAD 0x02aa000109966001 ;TTBR0_EL1
PER.Set SPR:0x34200 %QUAD 0x0000000000000000 ;TTBR0_EL2
PER.Set SPR:0x36200 %QUAD 0x0000000000000000 ;TTBR0_EL3
PER.Set SPR:0x30201 %QUAD 0x02aa00004247c001 ;TTBR1_EL1
PER.Set SPR:0x30100 %QUAD 0x000000003474591d ;SCTLR_EL1
PER.Set SPR:0x34100 %QUAD 0x0000000000000000 ;SCTLR_EL2
PER.Set SPR:0x36100 %QUAD 0x0000000000000000 ;SCTLR_EL3
PER.Set SPR:0x30202 %QUAD 0x000000f2b5593519 ;TCR_EL1
PER.Set SPR:0x34202 %QUAD 0x0000000000000000 ;TCR_EL2
PER.Set SPR:0x36202 %QUAD 0x0000000000000000 ;TCR_EL3
R.S sp_el0 0xffffff80036c5c80
R.S sp_el1 0xffffffc00801b850
R.S sp_el2 0x0000000000000000
R.S sp_el3 0x0000000000000000
; END MMU & SCTLR
; CPU4's Registers
core.select 4
R.S X0 0xffffff81d8eb9bc0
R.S X1 0xffffff80c4bd4080
R.S X2 0x0000000000000000
R.S X3 0x0000000000000010
R.S X4 0x0000000000000080
R.S X5 0x0000000000000001
R.S X6 0x0000000000000000
R.S X7 0x0000000000000001
R.S X8 0xffffff98bb54f000
R.S X9 0x000000007cbc8358
R.S X10 0x000000007cbc8356
R.S X11 0x000000000353f7cf
R.S X12 0x0000000000000020
R.S X13 0x00000000082eb988
R.S X14 0xffffff81d8eae958
R.S X15 0x0000fac4aaea0f00
R.S X16 0x0000000000000000
R.S X17 0x0000000000008000
R.S X18 0xffffffc008115030
R.S X19 0x00000067e6368d56
R.S X20 0xffffffe91ca1b6e8
R.S X21 0xffffffe91ca1a6a8
R.S X22 0x0000fa5cc3fc331d
R.S X23 0xffffff80c4bd4098
R.S X24 0x0cfcc6d1aad653fc
R.S X25 0xffffffe91da2c880
R.S X26 0x00000000099d89d9
R.S X27 0xffffffe91d989000
R.S X28 0xffffffe91dbb8660
R.S X29 0xffffffc008123e50
R.S X30 0xffffffe91c956848
R.S SP 0xffffffc008123e50
R.S PC 0xffffffe91c956864
R.S CPSR 0x80c00085
; END CPU Regs
; CPU4's MMU & System Control Registers
PER.Set SPR:0x30200 %QUAD 0x05a4000170eed001 ;TTBR0_EL1
PER.Set SPR:0x34200 %QUAD 0x0000000000000000 ;TTBR0_EL2
PER.Set SPR:0x36200 %QUAD 0x0000000000000000 ;TTBR0_EL3
PER.Set SPR:0x30201 %QUAD 0x05a400004247c001 ;TTBR1_EL1
PER.Set SPR:0x30100 %QUAD 0x000000003474591d ;SCTLR_EL1
PER.Set SPR:0x34100 %QUAD 0x0000000000000000 ;SCTLR_EL2
PER.Set SPR:0x36100 %QUAD 0x0000000000000000 ;SCTLR_EL3
PER.Set SPR:0x30202 %QUAD 0x000000f2b5593519 ;TCR_EL1
PER.Set SPR:0x34202 %QUAD 0x0000000000000000 ;TCR_EL2
PER.Set SPR:0x36202 %QUAD 0x0000000000000000 ;TCR_EL3
R.S sp_el0 0xffffff80c01f4a00
R.S sp_el1 0xffffffc008123e50
R.S sp_el2 0x0000000000000000
R.S sp_el3 0x0000000000000000
; END MMU & SCTLR
; CPU5's Registers
core.select 5
R.S X0 0xffffff81d8edabc0
R.S X1 0xffffff80c4bd0880
R.S X2 0x0000000000000000
R.S X3 0x0000000000000010
R.S X4 0x0000000000000080
R.S X5 0x0000000000000001
R.S X6 0x0000000000000000
R.S X7 0x0000000000000001
R.S X8 0xffffff98bb570000
R.S X9 0x00000000893666ac
R.S X10 0x00000000893666aa
R.S X11 0x000000000353f7cf
R.S X12 0x0000000000000020
R.S X13 0x00000000082eb98c
R.S X14 0x0000000000000010
R.S X15 0x0000000000000010
R.S X16 0x0000000000000001
R.S X17 0x0000000000008000
R.S X18 0xffffffc00811d030
R.S X19 0x00000067e67c04fe
R.S X20 0xffffffe91ca1b6e8
R.S X21 0xffffffe91ca1a6a8
R.S X22 0x0000fa5cc3fc331d
R.S X23 0xffffff80c4bd0898
R.S X24 0x0cfccf809fc2fbac
R.S X25 0xffffffe91da2c880
R.S X26 0x00000000099d89d9
R.S X27 0xffffffe91d989000
R.S X28 0xffffffe91dbb8660
R.S X29 0xffffffc00812be50
R.S X30 0xffffffe91c956848
R.S SP 0xffffffc00812be50
R.S PC 0xffffffe91c956864
R.S CPSR 0x80c00085
; END CPU Regs
; CPU5's MMU & System Control Registers
PER.Set SPR:0x30200 %QUAD 0x02aa000109966001 ;TTBR0_EL1
PER.Set SPR:0x34200 %QUAD 0x0000000000000000 ;TTBR0_EL2
PER.Set SPR:0x36200 %QUAD 0x0000000000000000 ;TTBR0_EL3
PER.Set SPR:0x30201 %QUAD 0x02aa00004247c001 ;TTBR1_EL1
PER.Set SPR:0x30100 %QUAD 0x000000003474591d ;SCTLR_EL1
PER.Set SPR:0x34100 %QUAD 0x0000000000000000 ;SCTLR_EL2
PER.Set SPR:0x36100 %QUAD 0x0000000000000000 ;SCTLR_EL3
PER.Set SPR:0x30202 %QUAD 0x000000f2b5593519 ;TCR_EL1
PER.Set SPR:0x34202 %QUAD 0x0000000000000000 ;TCR_EL2
PER.Set SPR:0x36202 %QUAD 0x0000000000000000 ;TCR_EL3
R.S sp_el0 0xffffff80c01f5c80
R.S sp_el1 0xffffffc00812be50
R.S sp_el2 0x0000000000000000
R.S sp_el3 0x0000000000000000
; END MMU & SCTLR
; CPU6's Registers
core.select 6
R.S X0 0x0000000000000000
R.S X1 0x000000775617ad28
R.S X2 0x0000000000000000
R.S X3 0x0000000000000008
R.S X4 0x000000775617acc0
R.S X5 0x00000079eb33afd0
R.S X6 0x000000775617acb0
R.S X7 0x00000000acd979ce
R.S X8 0x0000000000000007
R.S X9 0x000000604179d4a0
R.S X10 0x0000000080000000
R.S X11 0x0000000000000000
R.S X12 0xffffff80ffffffe0
R.S X13 0x00000000ffffffff
R.S X14 0x0000000000000001
R.S X15 0x00000000ffffffa5
R.S X16 0x00000079eb3aa210
R.S X17 0x00000079eb3456e0
R.S X18 0x00000079edf6c000
R.S X19 0x000000604179d000
R.S X20 0xb40000794adf7bd0
R.S X21 0x0000000000000006
R.S X22 0xb40000782adf4640
R.S X23 0x000000604179a7ac
R.S X24 0xb40000782adf4610
R.S X25 0x0000000000000006
R.S X26 0xb40000794adf7b70
R.S X27 0x00000060417990a4
R.S X28 0x00000079ed3ac000
R.S X29 0x0000007fd835ec00
R.S X30 0x000000604179b0b4
R.S SP 0xffffffc020234000
R.S PC 0x000000604179b0d0
R.S CPSR 0x60001000
; END CPU Regs
; CPU6's MMU & System Control Registers
PER.Set SPR:0x30200 %QUAD 0x39d800014a6c0001 ;TTBR0_EL1
PER.Set SPR:0x34200 %QUAD 0x0000000000000000 ;TTBR0_EL2
PER.Set SPR:0x36200 %QUAD 0x0000000000000000 ;TTBR0_EL3
PER.Set SPR:0x30201 %QUAD 0x39d900004247a001 ;TTBR1_EL1
PER.Set SPR:0x30100 %QUAD 0x000000003474d91d ;SCTLR_EL1
PER.Set SPR:0x34100 %QUAD 0x0000000000000000 ;SCTLR_EL2
PER.Set SPR:0x36100 %QUAD 0x0000000000000000 ;SCTLR_EL3
PER.Set SPR:0x30202 %QUAD 0x000001f2b5593519 ;TCR_EL1
PER.Set SPR:0x34202 %QUAD 0x0000000000000000 ;TCR_EL2
PER.Set SPR:0x36202 %QUAD 0x0000000000000000 ;TCR_EL3
R.S sp_el0 0x0000007fd835ebd0
R.S sp_el1 0xffffffc020234000
R.S sp_el2 0x0000000000000000
R.S sp_el3 0x0000000000000000
; END MMU & SCTLR
; CPU7's Registers
core.select 7
R.S X0 0xffffff81d8f1cbc0
R.S X1 0xffffff80c4bd7080
R.S X2 0x0000000000000000
R.S X3 0x0000000000000010
R.S X4 0x0000000000000080
R.S X5 0x0000000000000001
R.S X6 0x0000000000000000
R.S X7 0x0000000000000001
R.S X8 0xffffff98bb5b2000
R.S X9 0x0000000032e758a0
R.S X10 0x0000000032e7589e
R.S X11 0x000000000353f7cf
R.S X12 0x0000000000000020
R.S X13 0x00000000082eb986
R.S X14 0xffffff81d8f11958
R.S X15 0x0000fac4aaea0f00
R.S X16 0x0000000000000000
R.S X17 0x0000000000000240
R.S X18 0xffffffc00812d030
R.S X19 0x00000067e5f47d61
R.S X20 0xffffffe91ca1b6e8
R.S X21 0xffffffe91ca1a6a8
R.S X22 0x0000fa5cc3fc331d
R.S X23 0xffffff80c4bd7098
R.S X24 0x0cfcbe8fac24c459
R.S X25 0xffffffe91da2c880
R.S X26 0x00000000099d89d9
R.S X27 0xffffffe91d989000
R.S X28 0xffffffe91dbb8660
R.S X29 0xffffffc00813be50
R.S X30 0xffffffe91c956848
R.S SP 0xffffffc00813be50
R.S PC 0xffffffe91c956864
R.S CPSR 0x80c00085
; END CPU Regs
; CPU7's MMU & System Control Registers
PER.Set SPR:0x30200 %QUAD 0xff8400015e4c3001 ;TTBR0_EL1
PER.Set SPR:0x34200 %QUAD 0x0000000000000000 ;TTBR0_EL2
PER.Set SPR:0x36200 %QUAD 0x0000000000000000 ;TTBR0_EL3
PER.Set SPR:0x30201 %QUAD 0xff8400004247c001 ;TTBR1_EL1
PER.Set SPR:0x30100 %QUAD 0x000000003474d91d ;SCTLR_EL1
PER.Set SPR:0x34100 %QUAD 0x0000000000000000 ;SCTLR_EL2
PER.Set SPR:0x36100 %QUAD 0x0000000000000000 ;SCTLR_EL3
PER.Set SPR:0x30202 %QUAD 0x000001f2b5593519 ;TCR_EL1
PER.Set SPR:0x34202 %QUAD 0x0000000000000000 ;TCR_EL2
PER.Set SPR:0x36202 %QUAD 0x0000000000000000 ;TCR_EL3
R.S sp_el0 0xffffff80c01f0000
R.S sp_el1 0xffffffc00813be50
R.S sp_el2 0x0000000000000000
R.S sp_el3 0x0000000000000000
; END MMU & SCTLR
; select fault cpu
core.select 3
; select fault cpu
core.select 3
mmu.format linuxswap3 swapper_pg_dir 0xffffff8000000000--
0xffffffffffffffff 0x0000000000000000
trans.common 0xffffff8000000000--0xffffffffffffffff
trans.tw on
trans.on
mmu.scan

mmu.list.pagetable 0xffffff8000000000

; load the awareness for Linux-3.x on ARM
TASK.CONFIG ~~/demo/arm64/kernel/linux/linux-3.x/linux3.t32
; load Linux menu:
MENU.ReProgram ~~/demo/arm64/kernel/linux/linux-3.x/linux.men
task.dmesg

&ramdump_banner=V.STRING(linux_banner)
&t32_max_strlen=255.
IF &vmlinux_banner_len>=&t32_max_strlen
(
	&ramdump_build_time=STRing.SPLIT(V.STRING(&linux_banner[200]),"#", -1)

	PRINT %ERROR "vmlinux banner : [#&vmlinux_build_time] &vmlinux_banner"
	PRINT %ERROR "ramdump banner : [#&ramdump_build_time] &ramdump_banner"
	IF ("&vmlinux_banner"!="&ramdump_banner")
	(
	    PRINT %ERROR "!!!!!! No maching vmlinux symbol and dump binary..."
	    PRINT %ERROR "or check your mmu setting..."
	    ENDDO
	)

	IF ("&ramdump_build_time"!="&vmlinux_build_time")
	(
	    PRINT %ERROR "!!!!!!!!! No maching build time !!!!!!!!!"
	    PRINT %ERROR "check binary and vmlinux build time"
	    PRINT %ERROR "Symbole build time : #&vmlinux_build_time"
	    PRINT %ERROR "RAMDUM build time  : #&ramdump_build_time"
	)

)
ELSE
(
	PRINT %ERROR "vmlinux banner : &vmlinux_banner"
	PRINT %ERROR "ramdump banner : &ramdump_banner"
	IF ("&vmlinux_banner"!="&ramdump_banner")
	(
		PRINT %ERROR "!!!!!!! No maching vmlinux symbol and dump binary..."
		PRINT %ERROR "or check your mmu setting..."
		ENDDO
	)
)
;y.l.sec
l
r
f
WinPOS 0.0 0.0 100. 6. 0. 0. W000
AREA
ENDDO
;******************************************************
;*                    End CMM                         *
;******************************************************
