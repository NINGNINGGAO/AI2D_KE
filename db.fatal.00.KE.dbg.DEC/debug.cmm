; Generated by KSST64 v2.1

do ~~/t32.cmm
sys.res
sys.cpu CortexA55
sys.config.cn 8.
core.num 8.
sys.u
title os.pwd()

if os.file("symbols/scheduler.ko")
	gosub newfile scheduler.ko
if os.file("symbols/authon.ko")
	gosub newfile authon.ko
if os.file("symbols/pinctrl_mtk_v2.ko")
	gosub newfile pinctrl_mtk_v2.ko
d.load.e symbols/vmlinux 0x0000009F6A400000 /nc /ny
d.load.e symbols/vmlinux 0x0000001F6A400000 /nc /ncode
y.d _end
d.load.e SYS_MINI_RDUMP 0x0000008000000000 /nc /ny /logload
d.load.b scrutils/cmmmmu.bin 0x0000008000000000 /b /nc
global &MemMapAddr &ModStart &LinearStart &ThreadSize
&MemMapAddr=0x0000000000000000
&ModStart=0xFFFFFFC000000000
&LinearStart=0xFFFFFF8000000000
&ThreadSize=0x0000000000004000

menu.rp
(
	add
	menu
	(
		popup "Mediatek"
		(
			popup "CPU2 callstack"
			(
				menuitem "pick_next_task_fair()"
				(
					core.select 2
					r.s pc	0xFFFFFFDF725B9158
					r.s sp 	0xFFFFFFC008FEBD00
					r.s x0	0xFFFFFF80EB3BE820
					r.s x1	0x0000000000000000
					r.s x2	0x0000000000000000
					r.s x3	0xFFFFFF80D105A408
					r.s x4	0xFFFFFFC008FEBBC0
					r.s x5	0x00000000C5672A10
					r.s x6	0x01143E49035E3650
					r.s x7	0x342E38312020205B
					r.s x8	0xFFFFFF80CC1300C0
					r.s x9	0x0000000000100000
					r.s x10	0x0000000100000002
					r.s x11	0xFFFFFF80D0C53D68
					r.s x12	0x0000000000218FA6
					r.s x13	0x00000000002191C0
					r.s x14	0xFFFFFFDF74B6A850
					r.s x15	0x0000000000000A8C
					r.s x16	0x0000000000000A8C
					r.s x17	0x0000000000000A8C
					r.s x18	0xFFFFFFC008F95028
					r.s x19	0xFFFFFF81D8F1CE40
					r.s x20	0x0000000000000000
					r.s x21	0x0000000000000000
					r.s x22	0x0000000000000000
					r.s x23	0xFFFFFF80D11BDC80
					r.s x24	0x0000000000000004
					r.s x25	0xFFFFFFDF74D88000
					r.s x26	0xFFFFFF80D11BE378
					r.s x27	0xFFFFFFDF746F2020
					r.s x28	0xFFFFFFDF73C1B6E8
					r.s x29	0xFFFFFFC008FEBD20
					r.s x30	0xFFFFFFDF725B914C
				)
				menuitem "__schedule()"
				(
					core.select 2
					r.s pc	0xFFFFFFDF73E021A4
					r.s sp 	0xFFFFFFC008FEBD80
					r.s x0	0xFFFFFF80EB3BE820
					r.s x1	0x0000000000000000
					r.s x2	0x0000000000000000
					r.s x3	0xFFFFFF80D105A408
					r.s x4	0xFFFFFFC008FEBBC0
					r.s x5	0x00000000C5672A10
					r.s x6	0x01143E49035E3650
					r.s x7	0x342E38312020205B
					r.s x8	0xFFFFFF80CC1300C0
					r.s x9	0x0000000000100000
					r.s x10	0x0000000100000002
					r.s x11	0xFFFFFF80D0C53D68
					r.s x12	0x0000000000218FA6
					r.s x13	0x00000000002191C0
					r.s x14	0xFFFFFFDF74B6A850
					r.s x15	0x0000000000000A8C
					r.s x16	0x0000000000000A8C
					r.s x17	0x0000000000000A8C
					r.s x18	0xFFFFFFC008F95028
					r.s x19	0xFFFFFF81D8F1CE40
					r.s x20	0x0000000000000000
					r.s x21	0x0000000000000000
					r.s x22	0x0000000000000000
					r.s x23	0xFFFFFF80D11BDC80
					r.s x24	0x0000000000000004
					r.s x25	0xFFFFFFDF74D88000
					r.s x26	0xFFFFFF80D11BE378
					r.s x27	0xFFFFFFDF746F2020
					r.s x28	0xFFFFFFDF73C1B6E8
					r.s x29	0xFFFFFFC008FEBD80
					r.s x30	0xFFFFFFDF725B914C
				)
				menuitem "schedule()"
				(
					core.select 2
					r.s pc	0xFFFFFFDF73E02B60
					r.s sp 	0xFFFFFFC008FEBDE0
					r.s x0	0xFFFFFF80EB3BE820
					r.s x1	0x0000000000000000
					r.s x2	0x0000000000000000
					r.s x3	0xFFFFFF80D105A408
					r.s x4	0xFFFFFFC008FEBBC0
					r.s x5	0x00000000C5672A10
					r.s x6	0x01143E49035E3650
					r.s x7	0x342E38312020205B
					r.s x8	0xFFFFFF80CC1300C0
					r.s x9	0x0000000000100000
					r.s x10	0x0000000100000002
					r.s x11	0xFFFFFF80D0C53D68
					r.s x12	0x0000000000218FA6
					r.s x13	0x00000000002191C0
					r.s x14	0xFFFFFFDF74B6A850
					r.s x15	0x0000000000000A8C
					r.s x16	0x0000000000000A8C
					r.s x17	0x0000000000000A8C
					r.s x18	0xFFFFFFC008F95028
					r.s x19	0xFFFFFF81D8F1CE40
					r.s x20	0x0000000000000000
					r.s x21	0x0000000000000000
					r.s x22	0x0000000000000000
					r.s x23	0xFFFFFF80D11BDC80
					r.s x24	0x0000000000000004
					r.s x25	0xFFFFFFDF74D88000
					r.s x26	0xFFFFFF80D11BE378
					r.s x27	0xFFFFFFDF746F2020
					r.s x28	0xFFFFFFDF73C1B6E8
					r.s x29	0xFFFFFFC008FEBDE0
					r.s x30	0xFFFFFFDF725B914C
				)
				menuitem "worker_thread()"
				(
					core.select 2
					r.s pc	0xFFFFFFDF72570BB8
					r.s sp 	0xFFFFFFC008FEBE10
					r.s x0	0xFFFFFF80EB3BE820
					r.s x1	0x0000000000000000
					r.s x2	0x0000000000000000
					r.s x3	0xFFFFFF80D105A408
					r.s x4	0xFFFFFFC008FEBBC0
					r.s x5	0x00000000C5672A10
					r.s x6	0x01143E49035E3650
					r.s x7	0x342E38312020205B
					r.s x8	0xFFFFFF80CC1300C0
					r.s x9	0x0000000000100000
					r.s x10	0x0000000100000002
					r.s x11	0xFFFFFF80D0C53D68
					r.s x12	0x0000000000218FA6
					r.s x13	0x00000000002191C0
					r.s x14	0xFFFFFFDF74B6A850
					r.s x15	0x0000000000000A8C
					r.s x16	0x0000000000000A8C
					r.s x17	0x0000000000000A8C
					r.s x18	0xFFFFFFC008F95028
					r.s x19	0xFFFFFF81D8F1CE40
					r.s x20	0x0000000000000000
					r.s x21	0x0000000000000000
					r.s x22	0x0000000000000000
					r.s x23	0xFFFFFF80D11BDC80
					r.s x24	0x0000000000000004
					r.s x25	0xFFFFFFDF74D88000
					r.s x26	0xFFFFFF80D11BE378
					r.s x27	0xFFFFFFDF746F2020
					r.s x28	0xFFFFFFDF73C1B6E8
					r.s x29	0xFFFFFFC008FEBE10
					r.s x30	0xFFFFFFDF725B914C
				)
				menuitem "kthread()"
				(
					core.select 2
					r.s pc	0xFFFFFFDF7257F498
					r.s sp 	0xFFFFFFC008FEBE70
					r.s x0	0xFFFFFF80EB3BE820
					r.s x1	0x0000000000000000
					r.s x2	0x0000000000000000
					r.s x3	0xFFFFFF80D105A408
					r.s x4	0xFFFFFFC008FEBBC0
					r.s x5	0x00000000C5672A10
					r.s x6	0x01143E49035E3650
					r.s x7	0x342E38312020205B
					r.s x8	0xFFFFFF80CC1300C0
					r.s x9	0x0000000000100000
					r.s x10	0x0000000100000002
					r.s x11	0xFFFFFF80D0C53D68
					r.s x12	0x0000000000218FA6
					r.s x13	0x00000000002191C0
					r.s x14	0xFFFFFFDF74B6A850
					r.s x15	0x0000000000000A8C
					r.s x16	0x0000000000000A8C
					r.s x17	0x0000000000000A8C
					r.s x18	0xFFFFFFC008F95028
					r.s x19	0xFFFFFF81D8F1CE40
					r.s x20	0x0000000000000000
					r.s x21	0x0000000000000000
					r.s x22	0x0000000000000000
					r.s x23	0xFFFFFF80D11BDC80
					r.s x24	0x0000000000000004
					r.s x25	0xFFFFFFDF74D88000
					r.s x26	0xFFFFFF80D11BE378
					r.s x27	0xFFFFFFDF746F2020
					r.s x28	0xFFFFFFDF73C1B6E8
					r.s x29	0xFFFFFFC008FEBE70
					r.s x30	0xFFFFFFDF725B914C
				)
				menuitem "0xFFFFFFDF7241591C()"
				(
					core.select 2
					r.s pc	0xFFFFFFDF7241591C
					r.s sp 	0x0000000000000000
					r.s x0	0xFFFFFF80EB3BE820
					r.s x1	0x0000000000000000
					r.s x2	0x0000000000000000
					r.s x3	0xFFFFFF80D105A408
					r.s x4	0xFFFFFFC008FEBBC0
					r.s x5	0x00000000C5672A10
					r.s x6	0x01143E49035E3650
					r.s x7	0x342E38312020205B
					r.s x8	0xFFFFFF80CC1300C0
					r.s x9	0x0000000000100000
					r.s x10	0x0000000100000002
					r.s x11	0xFFFFFF80D0C53D68
					r.s x12	0x0000000000218FA6
					r.s x13	0x00000000002191C0
					r.s x14	0xFFFFFFDF74B6A850
					r.s x15	0x0000000000000A8C
					r.s x16	0x0000000000000A8C
					r.s x17	0x0000000000000A8C
					r.s x18	0xFFFFFFC008F95028
					r.s x19	0xFFFFFF81D8F1CE40
					r.s x20	0x0000000000000000
					r.s x21	0x0000000000000000
					r.s x22	0x0000000000000000
					r.s x23	0xFFFFFF80D11BDC80
					r.s x24	0x0000000000000004
					r.s x25	0xFFFFFFDF74D88000
					r.s x26	0xFFFFFF80D11BE378
					r.s x27	0xFFFFFFDF746F2020
					r.s x28	0xFFFFFFDF73C1B6E8
					r.s x29	0x0000000000000000
					r.s x30	0xFFFFFFDF725B914C
				)
			)
		)
	)
)

core.select 7
r.s sp_el0	0xFFFFFF80CC130000
r.s cpsr	0x0000000000400085
r.s pc	0xFFFFFFDF725E96F4
r.s sp 	0xFFFFFFC00803BD30
r.s x0	0xFFFFFF81D8F1CE40
r.s x1	0x0000000000000001
r.s x2	0x0000000000000001
r.s x3	0xFFFFFFC00803BEB0
r.s x4	0x0000000000000080
r.s x5	0xFFFFFFFFFFFFFF80
r.s x6	0xFFFFFFDF70B8C3F4
r.s x7	0x0000000098000000
r.s x8	0xFFFFFF81D8F1CE40
r.s x9	0x00000000001C0101
r.s x10	0x0000000000000000
r.s x11	0x0000000000000959
r.s x12	0xFFFFFFDF74B86000
r.s x13	0x0000000000002298
r.s x14	0x0000000000002710
r.s x15	0x0000000000002720
r.s x16	0x0000000000000008
r.s x17	0x0000000000060000
r.s x18	0xFFFFFFC00803D048
r.s x19	0xFFFFFF81D8F1CE40
r.s x20	0xFFFFFF80CC130000
r.s x21	0xFFFFFFDF74B86000
r.s x22	0x0000000000000007
r.s x23	0xFFFFFFDF74B8A558
r.s x24	0xFFFFFFDF74B6BE40
r.s x25	0xFFFFFF80CC130000
r.s x26	0x000000042107DACD
r.s x27	0xFFFFFF81D8F103C0
r.s x28	0xFFFFFF80CC130000
r.s x29	0xFFFFFFC00803BD40
r.s x30	0xFFFFFFDF725A3084
per.s spr:0x30201 %q 0x0000008000000000
per.s spr:0x30202 %q 0x000001F2B5593519
per.s spr:0x30100 %q 0x000000003474D91D
per.s spr:0x30A20 %q 0x0000BBFF440C0400
per.s spr:0x30A30 %q 0x0000000000000000

core.select 6
r.s sp_el0	0xFFFFFF80C119B780
r.s cpsr	0x0000000080400085
r.s pc	0xFFFFFFDF725E9828
r.s sp 	0xFFFFFFC0158137B0
r.s x0	0xFFFFFF81D8F1CE40
r.s x1	0x0000000000180101
r.s x2	0x0000000000000001
r.s x3	0xFFFFFFC0158138C4
r.s x4	0xFFFFFFC0158138C0
r.s x5	0x0000000000007000
r.s x6	0x0000000000000001
r.s x7	0x0000000000000007
r.s x8	0xFFFFFF81D8F1CE40
r.s x9	0xFFFFFFDF74B6D0C0
r.s x10	0xFFFFFF81D8EFD0C0
r.s x11	0xFFFFFF81D8EFD0C8
r.s x12	0x00000000001C0000
r.s x13	0x0000000000000000
r.s x14	0x0000000000000000
r.s x15	0xFFFFFFDF74B8A558
r.s x16	0x000000000000003A
r.s x17	0x000000000000003A
r.s x18	0xFFFFFFC01120D090
r.s x19	0x0000000000000080
r.s x20	0xFFFFFFDF74B8A558
r.s x21	0xFFFFFFDF74B89000
r.s x22	0xFFFFFFC0158138C0
r.s x23	0x0000000000000006
r.s x24	0xFFFFFFC015813998
r.s x25	0x0000000000000007
r.s x26	0xFFFFFFDF74B89DD0
r.s x27	0xFFFFFF81D8F1CE40
r.s x28	0x0000000000000080
r.s x29	0xFFFFFFC0158137B0
r.s x30	0xFFFFFFDF73E0F598
per.s spr:0x30201 %q 0x0000008000000000
per.s spr:0x30202 %q 0x000001F2B5593519
per.s spr:0x30100 %q 0x000000003474D91D
per.s spr:0x30A20 %q 0x0000BBFF440C0400
per.s spr:0x30A30 %q 0x0000000000000000

core.select 5
r.s sp_el0	0xFFFFFF80F84C5C80
r.s cpsr	0x0000000080400085
r.s pc	0xFFFFFFDF725E9828
r.s sp 	0xFFFFFFC015B4B790
r.s x0	0xFFFFFF81D8F1CE40
r.s x1	0x0000000000080101
r.s x2	0x0000000000000001
r.s x3	0xFFFFFFC015B4B8A4
r.s x4	0xFFFFFFC015B4B8A0
r.s x5	0x0000000000000000
r.s x6	0x0000000000000000
r.s x7	0x0000000000000000
r.s x8	0xFFFFFF81D8F1CE40
r.s x9	0xFFFFFFDF74B6D0C0
r.s x10	0xFFFFFF81D8EDC0C0
r.s x11	0xFFFFFF81D8EDC0C8
r.s x12	0x0000000000180000
r.s x13	0x0000000000000000
r.s x14	0x0000000000000000
r.s x15	0xFFFFFFDF74B8A558
r.s x16	0x000000000000003B
r.s x17	0x000000000000003B
r.s x18	0xFFFFFFC015B43090
r.s x19	0x0000000000000080
r.s x20	0xFFFFFFDF74B8A558
r.s x21	0xFFFFFFDF74B89000
r.s x22	0xFFFFFFC015B4B8A0
r.s x23	0x0000000000000005
r.s x24	0xFFFFFFC015B4B978
r.s x25	0x0000000000000007
r.s x26	0xFFFFFFDF74B89DD0
r.s x27	0xFFFFFF81D8F1CE40
r.s x28	0x0000000000000080
r.s x29	0xFFFFFFC015B4B790
r.s x30	0xFFFFFFDF73E0F598
per.s spr:0x30201 %q 0x0000008000000000
per.s spr:0x30202 %q 0x000000F2B5593519
per.s spr:0x30100 %q 0x000000003474591D
per.s spr:0x30A20 %q 0x0000BBFF440C0400
per.s spr:0x30A30 %q 0x0000000000000000

core.select 4
r.s sp_el0	0xFFFFFF8125871280
r.s cpsr	0x0000000000400085
r.s pc	0xFFFFFFDF725E986C
r.s sp 	0xFFFFFFC016A1B7B0
r.s x0	0xFFFFFF81D8F1CE40
r.s x1	0x0000000000000101
r.s x2	0x0000000000000001
r.s x3	0xFFFFFFC016A1B8C4
r.s x4	0xFFFFFFC016A1B8C0
r.s x5	0x0000000000006000
r.s x6	0x0000000000000000
r.s x7	0x0000000000000007
r.s x8	0xFFFFFF81D8F1CE40
r.s x9	0xFFFFFFDF74B6D0C0
r.s x10	0xFFFFFF81D8EBB0C0
r.s x11	0x0000000000000000
r.s x12	0x0000000000140000
r.s x13	0x00000000001C0101
r.s x14	0x0000000000000000
r.s x15	0x0000000000000000
r.s x16	0x00000000000000B4
r.s x17	0x0002203A421B1D68
r.s x18	0xFFFFFFC016885090
r.s x19	0x0000000000000080
r.s x20	0xFFFFFFDF74B8A558
r.s x21	0xFFFFFFDF74B89000
r.s x22	0xFFFFFFC016A1B8C0
r.s x23	0x0000000000000004
r.s x24	0xFFFFFFC016A1B998
r.s x25	0x0000000000000007
r.s x26	0xFFFFFFDF74B89DD0
r.s x27	0xFFFFFF81D8F1CE40
r.s x28	0x0000000000000080
r.s x29	0xFFFFFFC016A1B7B0
r.s x30	0xFFFFFFDF73E0F598
per.s spr:0x30201 %q 0x0000008000000000
per.s spr:0x30202 %q 0x000000F2B5593519
per.s spr:0x30100 %q 0x000000003474591D
per.s spr:0x30A20 %q 0x0000BBFF440C0400
per.s spr:0x30A30 %q 0x0000000000000000

core.select 3
r.s sp_el0	0xFFFFFF80F1B98000
r.s cpsr	0x0000000000400085
r.s pc	0xFFFFFFDF725E96F4
r.s sp 	0xFFFFFFC00801BC80
r.s x0	0xFFFFFFDF6FEC4080
r.s x1	0x0000000000000001
r.s x2	0x0000000000000001
r.s x3	0xFFFFFF80D105B808
r.s x4	0xFFFFFFC00801BBB0
r.s x5	0x00000000EAC0C6E6
r.s x6	0x006D8757FA0D9BDA
r.s x7	0x203430373735203D
r.s x8	0xFFFFFFDF6FEC4080
r.s x9	0x0000000000000101
r.s x10	0x0000000000000000
r.s x11	0x0000000000000000
r.s x12	0x0000000000000000
r.s x13	0xFFFFFFDF74B86000
r.s x14	0x0000000000000000
r.s x15	0x0000000000000000
r.s x16	0x0000000000000283
r.s x17	0x0000000000000283
r.s x18	0xFFFFFFC00801D068
r.s x19	0xFFFFFF81D8E98E40
r.s x20	0xFFFFFF80F1B98000
r.s x21	0xFFFFFF80D115DD00
r.s x22	0x0000000000000003
r.s x23	0x00000000000AAE60
r.s x24	0xFFFFFFDF74B8A558
r.s x25	0xFFFFFFDF74B6BE40
r.s x26	0x00000000001E8480
r.s x27	0x0000000000000003
r.s x28	0xFFFFFFDF73C1B6E8
r.s x29	0xFFFFFFC00801BC80
r.s x30	0xFFFFFFDF73E0F778
per.s spr:0x30201 %q 0x0000008000000000
per.s spr:0x30202 %q 0x000000F2B5593519
per.s spr:0x30100 %q 0x000000003474591D
per.s spr:0x30A20 %q 0x0000BBFF440C0400
per.s spr:0x30A30 %q 0x0000000000000000

core.select 2
r.s sp_el0	0xFFFFFF80D11BDC80
r.s cpsr	0x0000000080C00085
r.s pc	0xFFFFFFDF725B9158
r.s sp 	0xFFFFFFC008FEBD00
r.s x0	0xFFFFFF80EB3BE820
r.s x1	0x0000000000000000
r.s x2	0x0000000000000000
r.s x3	0xFFFFFF80D105A408
r.s x4	0xFFFFFFC008FEBBC0
r.s x5	0x00000000C5672A10
r.s x6	0x01143E49035E3650
r.s x7	0x342E38312020205B
r.s x8	0xFFFFFF80CC1300C0
r.s x9	0x0000000000100000
r.s x10	0x0000000100000002
r.s x11	0xFFFFFF80D0C53D68
r.s x12	0x0000000000218FA6
r.s x13	0x00000000002191C0
r.s x14	0xFFFFFFDF74B6A850
r.s x15	0x0000000000000A8C
r.s x16	0x0000000000000A8C
r.s x17	0x0000000000000A8C
r.s x18	0xFFFFFFC008F95028
r.s x19	0xFFFFFF81D8F1CE40
r.s x20	0x0000000000000000
r.s x21	0x0000000000000000
r.s x22	0x0000000000000000
r.s x23	0xFFFFFF80D11BDC80
r.s x24	0x0000000000000004
r.s x25	0xFFFFFFDF74D88000
r.s x26	0xFFFFFF80D11BE378
r.s x27	0xFFFFFFDF746F2020
r.s x28	0xFFFFFFDF73C1B6E8
r.s x29	0xFFFFFFC008FEBD20
r.s x30	0xFFFFFFDF725B914C
per.s spr:0x30201 %q 0x0000008000000000
per.s spr:0x30202 %q 0x000000F2B5593519
per.s spr:0x30100 %q 0x000000003474591D
per.s spr:0x30A20 %q 0x0000BBFF440C0400
per.s spr:0x30A30 %q 0x0000000000000000

core.select 1
r.s sp_el0	0xFFFFFF810C918000
r.s cpsr	0x0000000080400085
r.s pc	0xFFFFFFDF725E9828
r.s sp 	0xFFFFFFC00800BBF0
r.s x0	0xFFFFFF81D8F1CE40
r.s x1	0x0000000000140101
r.s x2	0x0000000000000001
r.s x3	0xFFFFFFFFFFFFFFFE
r.s x4	0xFFFFFF81D8E35E40
r.s x5	0x0000000000000000
r.s x6	0xFFFFFFDF74B9BE80
r.s x7	0x00000000002DC6C0
r.s x8	0xFFFFFF81D8F1CE40
r.s x9	0xFFFFFFDF74B6D0C0
r.s x10	0xFFFFFF81D8E580C0
r.s x11	0xFFFFFF81D8E580C8
r.s x12	0x0000000000080000
r.s x13	0x0000000000000000
r.s x14	0x0000000000000000
r.s x15	0xFFFFFFDF74B8A558
r.s x16	0x0000000000000000
r.s x17	0xFFFFFFFFFFFFFFFF
r.s x18	0xFFFFFFC00800D070
r.s x19	0x00000000005B8D80
r.s x20	0xFFFFFFDF74B89000
r.s x21	0x0000000000000000
r.s x22	0x0000000000000007
r.s x23	0xFFFFFFDF74B89DE8
r.s x24	0xFFFFFF81D8F1CE40
r.s x25	0xFFFFFFDF74B8A558
r.s x26	0x0000000000000001
r.s x27	0x0000000000000001
r.s x28	0xFFFFFFDF74B6BE40
r.s x29	0xFFFFFFC00800BBF0
r.s x30	0xFFFFFFDF73E0F778
per.s spr:0x30201 %q 0x0000008000000000
per.s spr:0x30202 %q 0x000000F2B5593519
per.s spr:0x30100 %q 0x000000003474591D
per.s spr:0x30A20 %q 0x0000BBFF440C0400
per.s spr:0x30A30 %q 0x0000000000000000

core.select 0
r.s sp_el0	0xFFFFFF80C019CA00
r.s cpsr	0x0000000080C00085
r.s pc	0xFFFFFFDF6E21D25C
r.s sp 	0xFFFFFFC0080CB1D0
r.s x0	0x0000000000000000
r.s x1	0xFFFFFFDF6E235478
r.s x2	0x0000000000000002
r.s x3	0xFFFFFFC0080CB1D8
r.s x4	0xFFFFFFFFFFFFFFE0
r.s x5	0x0000000000000040
r.s x6	0x000000000000003F
r.s x7	0x0000000000000000
r.s x8	0x0000000038920888
r.s x9	0xFFFFFF80CDC68A80
r.s x10	0x0000000000000210
r.s x11	0x0000000000000020
r.s x12	0x0000000000000210
r.s x13	0x0000000000000014
r.s x14	0x0000000000000012
r.s x15	0x0000000000000020
r.s x16	0x000000000000003F
r.s x17	0x0000000000000001
r.s x18	0xFFFFFFC0080BD060
r.s x19	0xFFFFFFC0080CB224
r.s x20	0x0000000000000000
r.s x21	0xFFFFFFC00896D210
r.s x22	0xFFFFFFDF6E222DC0
r.s x23	0xFFFFFFDF6F1DA808
r.s x24	0x000000000000000D
r.s x25	0x00000000000002FE
r.s x26	0x0000000000001194
r.s x27	0xFFFFFF80D0DBC538
r.s x28	0xFFFFFFDF6F1DA7F0
r.s x29	0xFFFFFFC0080CB1F0
r.s x30	0xFFFFFFDF6E21D218
per.s spr:0x30201 %q 0x0000008000000000
per.s spr:0x30202 %q 0x000000F2B5593519
per.s spr:0x30100 %q 0x000000003474591D
per.s spr:0x30A20 %q 0x0000BBFF440C0400
per.s spr:0x30A30 %q 0x0000000000000000
trans.common 0xFFFFFF8000000000--0xFFFFFFFFFFFFFFFF
trans.tw on
trans.on

core.select 2
y.spath src
setup.v %h.on %s.on %y.on
wclear
wpos 0% 0% 50% 100%
w.v.f /a /l
wpos 50% 0%
w.r
wpos 50% 30%
d.l
enddo
newfile:
	entry &file
	dialog
	(&
		header "New file exist"
		pos 0. 0. 28. 1.
		text "[Warning]Detect &file exist."
		text "Please rerun 'NK/KE-Analyze' to check if matched."
		pos 2. 3. 24. 1.
		defbutton "OK" "quit"
		close "quit"
	)
	enddo